## boards/nuvoton/numaker_pfm_m453/Kconfig.numaker_pfm_m453
```kconfig
# SPDX-License-Identifier: Apache-2.0

config BOARD_NUMAKER_PFM_M453
	select SOC_M453
```

## boards/nuvoton/numaker_pfm_m453/board.yml
```yaml
board:
  name: numaker_pfm_m453
  full_name: NUMAKER PFM M453VG6AE
  vendor: nuvoton
  socs:
  - name: m453
```

## drivers/counter/Kconfig.numaker
```kconfig
# Nuvoton Numaker timer counter driver configuration

# Copyright (c) 2025 iWorx Systems Inc.
# SPDX-License-Identifier: Apache-2.0

config COUNTER_TIMER_NUMAKER
	bool "Nuvoton NuMaker timer counter driver"
	default y
	depends on DT_HAS_NUVOTON_NUMAKER_TIMER_ENABLED
	help
	  Enable counter driver for Nuvoton NuMaker series timer peripherals.
```

## drivers/dac/Kconfig.numaker
```kconfig
# Copyright (c) 2024 Nuvoton Technology Corporation.
# SPDX-License-Identifier: Apache-2.0

config DAC_NUMAKER
	bool "Nuvoton NuMaker DAC driver"
	default y
	depends on DT_HAS_NUVOTON_NUMAKER_DAC_ENABLED
	select PINCTRL
	select HAS_NUMAKER_DAC
	help
	  Enable the DAC driver for Nuvoton NuMaker family of processors.
```

## drivers/pwm/Kconfig.numaker_basic
```kconfig
# NUMAKER BPWM Driver configuration options

# Copyright (c) 2023 Nuvoton Technology Corporation.
# SPDX-License-Identifier: Apache-2.0

config PWM_NUMAKER_BASIC
	bool "Nuvoton NuMaker MCU BPWM driver"
	default y
	select HAS_NUMAKER_BPWM
	select PINCTRL
	depends on DT_HAS_NUVOTON_NUMAKER_BPWM_ENABLED
	help
	  This option enables the BPWM driver for Nuvoton NuMaker family of
	  processors.
	  Say y if you wish to enable NuMaker BPWM.
```

## drivers/sensor/maxim/max31856/Kconfig
```kconfig
# MAX31856 cold-junction compensated thermocouple-to-digital converter configuration options

# Copyright (c) 2020 Christian Hirsch
# SPDX-License-Identifier: Apache-2.0

config MAX31856
	bool "MAX31856 sensor"
	default y
	depends on DT_HAS_MAXIM_MAX31856_ENABLED
	select SPI
	help
	  Enable driver for MAX31856 SPI-based Cold-Junction Compensated thermocouple-to-Digital Converter.
```

## dts/bindings/counter/nuvoton,numaker-timer.yaml
```yaml
# Copyright (c) 2025 iWorx Systems Inc.
# SPDX-License-Identifier: Apache-2.0

description: Nuvoton NuMaker Timer Counter

compatible: "nuvoton,numaker-timer"

include: [base.yaml, reset-device.yaml, pinctrl-device.yaml]

properties:
  reg:
    required: true

  interrupts:
    required: true

  resets:
    required: true

  clocks:
    required: true

  prescaler:
    type: int
    default: 0
    description: |
      Timer prescaler value (0-255). The timer input clock is divided
      by (prescaler + 1).

  count-edge:
    type: string
    enum:
      - "rising"
      - "falling"
    description: |
      Selects which edge of the TMx input signal increments the counter.
      Setting this property enables event counter mode — the timer counts
      external edges on the TMx pin instead of an internal clock.

  output-clk:
    type: boolean
    description: |
      Enable toggle output mode on the TMx pin. When set, the timer
      toggles the TMx output pin each time the counter matches the
      compare value.

  trigger-pdma:
    type: boolean
    description: |
      Enable PDMA trigger output.  When set, the timer generates DMA
      transfer requests to the PDMA controller on each selected event.
      The PDMA channel must be configured separately with the
      corresponding NUMAKER_PDMA_TMRx request source.

  trigger-source:
    type: string
    enum:
      - "timeout"
      - "capture"
    description: |
      Selects which timer event triggers the PDMA request (only used
      when trigger-pdma is set):
      "timeout" - Timeout event (counter matches compare value). Useful
                  with event counter mode to trigger DMA every N external
                  pulses.
      "capture" - Capture event (edge detected on TMx_EXT pin).
```

## dts/bindings/dac/nuvoton,numaker-dac.yaml
```yaml
# Copyright (c) 2024 Nuvoton Technology Corporation.
# SPDX-License-Identifier: Apache-2.0

description: Nuvoton NuMaker DAC controller

compatible: "nuvoton,numaker-dac"

include: [dac-controller.yaml, reset-device.yaml, pinctrl-device.yaml]

properties:
  reg:
    required: true

  clocks:
    required: true

  resets:
    required: true

  "#io-channel-cells":
    const: 1

io-channel-cells:
  - output
```

## dts/bindings/dma/nuvoton,numaker-pdma.yaml
```yaml
# Copyright (c) 2026
# SPDX-License-Identifier: Apache-2.0

description: Nuvoton NuMaker PDMA controller

compatible: "nuvoton,numaker-pdma"

include: [dma-controller.yaml, reset-device.yaml]

properties:
  reg:
    required: true

  interrupts:
    required: true

  resets:
    required: true

  clocks:
    required: true

  dma-channels:
    required: true

  dma-requests:
    required: true

  "#dma-cells":
    const: 2

dma-cells:
  - channel
  - slot
```

## dts/bindings/gpio/ti,sn74hc595.yaml
```yaml
# Copyright (c) 2022, Matthias Freese
# SPDX-License-Identifier: Apache-2.0

description: SN74HC595 SPI based GPIO expander

compatible: "ti,sn74hc595"

include: [gpio-controller.yaml, spi-device.yaml]

properties:
  reset-gpios:
    type: phandle-array
    description: Reset pin

  ngpios:
    type: int
    required: true
    const: 8
    description: Number of supported gpios

  cs-invert:
    type: boolean
    description: |
      If the chip select connected to the "RCLK" pin on the 
      shift register has an inverter between it and the 
      microcontroller, this can be set to invert the chip 
      select polarity. This is useful in cases where you are
      using the shift register across an isolation barrier for
      say configurating GPIO on an SPI ADC and you do not want
      to add an extra isolated gpio for the chip select.

  "#gpio-cells":
    const: 2

gpio-cells:
  - pin
  - flags
```

## dts/bindings/sensor/maxim,max31856.yaml
```yaml
# Copyright (c) 2020, Christian Hirsch
# SPDX-License-Identifier: Apache-2.0

description: MAX31856 SPI-based cold-junction compensated thermocouple-to-digital converter.

compatible: "maxim,max31856"

include: [sensor-device.yaml, spi-device.yaml]

properties:

  num-sample-to-avg:
    default: 1
    type: int
    enum:
      - 1
      - 2
      - 4
      - 8
      - 16

  thermocouple-type:
    default: "K"
    type: string
    enum:
      - "B"
      - "E"
      - "J"
      - "K"
      - "N"
      - "R"
      - "S"
      - "T"
    description: The type of thermocouple connector on the board. 

  fault-gpios:
    type: phandle-array

  drdy-gpios:
    type: phandle-array
```

## dts/bindings/spi/nuvoton,numaker-spi.yaml
```yaml
# Copyright (c) 2023 Nuvoton Technology Corporation.
# SPDX-License-Identifier: Apache-2.0

description: Nuvoton, NuMaker SPI controller

compatible: "nuvoton,numaker-spi"

include: [spi-controller.yaml, reset-device.yaml, pinctrl-device.yaml]

properties:
  reg:
    required: true

  interrupts:
    required: true

  resets:
    required: true

  clocks:
    required: true

  dmas:
    required: false
    description: DMA specifiers for SPI transfers, ordered as TX and RX.

  dma-names:
    required: false
    description: DMA channel names. Must be "tx", "rx" when present.
```

## soc/nuvoton/numicro/Kconfig
```kconfig
# SPDX-License-Identifier: Apache-2.0
#
# Copyright (c) 2020 Linumiz
# Author: Saravanan Sekar <saravanan@linumiz.com>

config SOC_FAMILY_NUMICRO
	select SOC_RESET_HOOK
	select HAS_SEGGER_RTT if ZEPHYR_SEGGER_MODULE

if SOC_FAMILY_NUMICRO

rsource "*/Kconfig"

endif # SOC_FAMILY_NUMICRO
```

## soc/nuvoton/numicro/m45x/Kconfig
```kconfig
# SPDX-License-Identifier: Apache-2.0

config SOC_SERIES_M45X
	select ARM
	select CPU_CORTEX_M4
	select CPU_CORTEX_M_HAS_DWT
	select CPU_HAS_FPU
	select CPU_HAS_ARM_MPU
	select RESET
	select CORTEX_M_SYSTICK if SYS_CLOCK_EXISTS

config SOC_M453
	select HAS_NUMICRO_HAL
	select HAS_NUMAKER_HAL
```

## soc/nuvoton/numicro/m45x/Kconfig.defconfig
```kconfig
# SPDX-License-Identifier: Apache-2.0

if SOC_SERIES_M45X

rsource "Kconfig.defconfig.m45*"

config RESET
	default y

endif # SOC_SERIES_M45X
```

## soc/nuvoton/numicro/m45x/Kconfig.defconfig.m453
```kconfig
# SPDX-License-Identifier: Apache-2.0

if SOC_M453

config NUM_IRQS
	default 64

endif # SOC_M453
```

## soc/nuvoton/numicro/m45x/Kconfig.soc
```kconfig
# SPDX-License-Identifier: Apache-2.0

config SOC_SERIES_M45X
	bool
	select SOC_FAMILY_NUMICRO
	select SOC_FAMILY_NUMAKER
	help
	  Enable support for NUVOTON M45X MCU series

config SOC_M453
	bool
	select SOC_SERIES_M45X

config SOC_SERIES
	default "m45x" if SOC_SERIES_M45X

config SOC
	default "m453" if SOC_M453
```

## soc/nuvoton/numicro/m48x/Kconfig.defconfig
```kconfig
# SPDX-License-Identifier: Apache-2.0
#
# Copyright (c) 2020 Linumiz
# Author: Saravanan Sekar <saravanan@linumiz.com>

if SOC_SERIES_M48X

rsource "Kconfig.defconfig.m48*"

config RESET
	default y

endif # SOC_SERIES_M48X
```

## soc/nuvoton/numicro/m48x/Kconfig.defconfig.m487
```kconfig
# SPDX-License-Identifier: Apache-2.0
#
# Copyright (c) 2020 Linumiz
# Author: Saravanan Sekar <saravanan@linumiz.com>

if SOC_M483 || SOC_M484 || SOC_M487

config NUM_IRQS
	default 108

endif # SOC_M483 || SOC_M484 || SOC_M487
```
