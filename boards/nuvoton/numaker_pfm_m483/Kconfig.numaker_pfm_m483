## boards/nuvoton/numaker_pfm_m483/Kconfig.numaker_pfm_m483
```kconfig
# SPDX-License-Identifier: Apache-2.0
#
# Nuvoton PFM M483 board configuration
#
# Copyright (c) 2026 iWorx Systems

config BOARD_NUMAKER_PFM_M483
	select SOC_M483
```

## boards/nuvoton/numaker_pfm_m483/board.yml
```yaml
board:
  name: numaker_pfm_m483
  full_name: NUMAKER PFM M483
  vendor: nuvoton
  socs:
  - name: m483
```

## drivers/dma/Kconfig.numaker
```kconfig
# Copyright (c) 2026
# SPDX-License-Identifier: Apache-2.0

config DMA_NUMAKER_PDMA
	bool "Nuvoton NuMaker PDMA driver"
	default y
	select HAS_NUMAKER_PDMA
	depends on DT_HAS_NUVOTON_NUMAKER_PDMA_ENABLED
	help
	  Enable PDMA driver for Nuvoton NuMicro M480 series devices.

if DMA_NUMAKER_PDMA

config DMA_NUMAKER_MAX_SCATTER_GATHER_COUNT
	int "Max scatter-gather chain depth per channel (0 disables SG)"
	default 0
	range 0 16
	help
	  Maximum number of blocks in a scatter-gather chain that the
	  driver will accept on any one channel. Sizes the per-instance
	  SRAM descriptor table at
	  dma-channels * DMA_NUMAKER_MAX_SCATTER_GATHER_COUNT * sizeof(DSCT_T).

	  Set to 0 to drop scatter-gather support entirely. With SG
	  disabled the descriptor table is not allocated, the SCATBA
	  register write at init is skipped, and any dma_config call with
	  block_count > 1 returns -ENOTSUP. Apps that only use single-
	  block transfers (the common case) save dma-channels * 16 *
	  16 bytes of SRAM by leaving this at 0.

	  The m48x soc is limited to 16 entries.

endif # DMA_NUMAKER_PDMA
```

## drivers/usb/udc/Kconfig.numaker
```kconfig
# Copyright (c) 2024 Nuvoton Technology Corporation
# SPDX-License-Identifier: Apache-2.0

config UDC_NUMAKER
	bool "Nuvoton NuMaker USB device controller"
	default y
	depends on DT_HAS_NUVOTON_NUMAKER_USBD_ENABLED \
		|| DT_HAS_NUVOTON_NUMAKER_HSUSBD_ENABLED
	select PINCTRL
	select UDC_DRIVER_HAS_HIGH_SPEED_SUPPORT if DT_HAS_NUVOTON_NUMAKER_HSUSBD_ENABLED
	select EVENTS
	help
	  Enable Nuvoton NuMaker USB device controller driver

if UDC_NUMAKER

config UDC_NUMAKER_MSG_QUEUE_SIZE
	int "UDC NuMaker message queue size"
	default 32
	help
	  Maximum number of messages the driver can queue for interrupt bottom half processing.

config UDC_NUMAKER_THREAD_STACK_SIZE
	int "UDC NuMaker driver internal thread stack size"
	default 1536
	help
	  Size of the stack for the driver internal thread.

config UDC_NUMAKER_THREAD_PRIORITY
	int "UDC NuMaker driver internal thread priority"
	default 8
	help
	  Priority of the driver internal thread.

config UDC_NUMAKER_DMA
	bool "UDC NuMaker DMA support"
	default y
	depends on DT_HAS_NUVOTON_NUMAKER_HSUSBD_ENABLED
	help
	  This enables DMA transfer between user buffer and USB buffer.

config UDC_NUMAKER_DMA_TIMEOUT_MS
	int "UDC NuMaker DMA timeout"
	default 2000
	depends on UDC_NUMAKER_DMA
	help
	  This configures timeout of DMA transfer in milliseconds.

config UDC_NUMAKER_PROBE
	bool "UDC NuMaker latency probes (for throughput investigation)"
	default n
	help
	  Enable cycle-counter probes inside the IN-direction critical
	  path (xfer_in, DMA wait, msg_handle_in, ISR -> handler latency).
	  Use udc_numaker_probe_dump_to_printk() to dump histograms.
	  Adds a few atomic ops per URB; not for production builds.

config UDC_NUMAKER_FAST_IN
	bool "UDC NuMaker fast-in DMA chaining (HSUSBD)"
	default n
	depends on UDC_NUMAKER_DMA
	help
	  Pump multi-packet bulk IN URBs entirely from IRQ context: the
	  TXPKIF ISR re-arms the next DMA chunk and the DMA-done ISR
	  re-enables TXPKIEN, so the UDC thread is involved only at URB
	  start and URB completion (not per packet).  Cuts per-packet
	  software roundtrip from ~40 us to ~15 us on M487.  Only one IN
	  URB can be fast-pathed at a time; concurrent IN EPs fall back
	  to the slow path.

endif # UDC_NUMAKER
```

## dts/bindings/usb/nuvoton,numaker-hsusbd.yaml
```yaml
# Copyright (c) 2022 Nuvoton Technology Corporation
# SPDX-License-Identifier: Apache-2.0

description: Nuvoton NuMaker high-speed USB 2.0 device controller

compatible: "nuvoton,numaker-hsusbd"

include: [usb-ep.yaml, reset-device.yaml, pinctrl-device.yaml]

properties:
  reg:
    required: true

  interrupts:
    required: true

  resets:
    required: true

  clocks:
    required: true

  dma-buffer-size:
    type: int
    required: true
    description: |
      Size of DMA buffer in bytes

  allow-disable-usb-on-unplug:
    type: boolean
    description: |
      Supports USB controller can be disabled temporarily when USB cable is unplugged
      and then enabled back when the cable is re-plugged.

  bulk-ep-buf-packets:
    type: array
    description: |
      Per-endpoint bulk FIFO depth in MPS-sized packets, as flat
      (endpoint-address, packet-count) pairs.  Reserves
      packet-count * MPS bytes of HSUSBD DMA buffer for the listed
      endpoints at ep_enable time, allowing HW to pipeline DMA fill
      with USB transmission (paired with UDC_NUMAKER_FAST_IN).
      Endpoints not listed default to 1 (MPS-only).  The total
      reservation across all bulk endpoints cannot exceed
      dma-buffer-size; the driver falls back to MPS for any EP whose
      enlarged request will not fit.

      Example — 4-MPS depth on bulk-IN 0x81 (the bulk-OUT 0x02 is
      omitted so it falls back to MPS):

          bulk-ep-buf-packets = <0x81 4>;
```
